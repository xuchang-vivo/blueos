## kernel/kernel/src/allocator/Kconfig
```kconfig
# Memory allocation algorithm configuration

choice
    prompt "Memory allocation algorithm"
    default ALLOCATOR_TLSF
    config ALLOCATOR_TLSF
        bool "TLSF algorithm"
    config ALLOCATOR_SLAB
        bool "SLAB algorithm (static)"
    config ALLOCATOR_SLAB_DYNAMIC
        bool "SLAB algorithm (dynamic, with page pool)"
    config ALLOCATOR_LLFF
        bool "LLFF algorithm"
endchoice

config ALLOCATOR
    string
    default "tlsf" if ALLOCATOR_TLSF
    default "slab" if ALLOCATOR_SLAB
    default "slab_dynamic" if ALLOCATOR_SLAB_DYNAMIC
    default "llff" if ALLOCATOR_LLFF

config SLAB_DEBUG
    bool "Enable SLAB allocator debug logging"
    default n
    depends on ALLOCATOR_SLAB || ALLOCATOR_SLAB_DYNAMIC
    help
      Enable debug logging for SLAB allocator operations including
      page allocation, deallocation, and pool management.

config SLAB_DYNAMIC_MAX_TOTAL_PAGES
    int "Max total pages in page pool"
    default 32
    depends on ALLOCATOR_SLAB_DYNAMIC

config ALLOCATOR_BUDDY
    bool "Enable buddy allocator as physical page manager"
    depends on !PAGING
    default n
    help
        Enable the buddy allocator to manage all physical memory pages.
        This can coexist with TLSF/SLAB/LLFF, which remain the selected
        heap allocator for small allocations.
        When enabled, slab allocator operates on top of buddy-allocated
        page pools; >= PAGE_SIZE allocations go directly to buddy;
        tlsf/llff keep their original __heap_start~__heap_end path.
        When disabled, the kernel falls back to direct heap management.
        Paging uses its shared frame allocator instead; the independent buddy
        initialization must not manage the same physical pages.

config KERNEL_HEAP_SIZE_KB
    int "Kernel heap size in KiB"
    depends on PAGING
    range 4 1048576
    default 16384
    help
        Physical backing reserved for the fixed kernel heap on paging systems.
        Remaining frames stay available for page tables and user memory.
        The size must be a multiple of the page size. Boot fails if the heap
        cannot be backed contiguously while leaving runtime frames available.
```
